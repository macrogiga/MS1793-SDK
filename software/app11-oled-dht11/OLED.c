/*
    Copyright (c) 2018 Macrogiga Electronics Co., Ltd.

    Permission is hereby granted, free of charge, to any person 
    obtaining a copy of this software and associated documentation 
    files (the "Software"), to deal in the Software without 
    restriction, including without limitation the rights to use, copy, 
    modify, merge, publish, distribute, sublicense, and/or sell copies 
    of the Software, and to permit persons to whom the Software is 
    furnished to do so, subject to the following conditions:

    The above copyright notice and this permission notice shall be 
    included in all copies or substantial portions of the Software.

    THE SOFTWARE IS PROVIDED "AS IS", WITHOUT WARRANTY OF ANY KIND, 
    EXPRESS OR IMPLIED, INCLUDING BUT NOT LIMITED TO THE WARRANTIES OF 
    MERCHANTABILITY, FITNESS FOR A PARTICULAR PURPOSE AND 
    NONINFRINGEMENT. IN NO EVENT SHALL THE AUTHORS OR COPYRIGHT 
    HOLDERS BE LIABLE FOR ANY CLAIM, DAMAGES OR OTHER LIABILITY, 
    WHETHER IN AN ACTION OF CONTRACT, TORT OR OTHERWISE, ARISING FROM, 
    OUT OF OR IN CONNECTION WITH THE SOFTWARE OR THE USE OR OTHER 
    DEALINGS IN THE SOFTWARE.
*/
#include "BSP.h"
#include "oled.h"


/************************************6*8�ַ�����************************************/
static const unsigned char CharTab6x8[95][6] =
{
{0x00, 0x00, 0x00, 0x00, 0x00, 0x00},// sp
{0x00, 0x00, 0x00, 0x2f, 0x00, 0x00},// !
{0x00, 0x00, 0x07, 0x00, 0x07, 0x00},// "
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{0x00, 0x08, 0x04, 0x08, 0x10, 0x08}// ~
};

/****************************************8*16???************************************/
const unsigned char CharTab8x16[95][16] =
{
  0x00,0x00,0x00,0x00,0x00,0x00,0x00,0x00,0x00,0x00,0x00,0x00,0x00,0x00,0x00,0x00,// 0
  0x00,0x00,0x00,0xF8,0x00,0x00,0x00,0x00,0x00,0x00,0x00,0x33,0x30,0x00,0x00,0x00,//! 1
  0x00,0x10,0x0C,0x06,0x10,0x0C,0x06,0x00,0x00,0x00,0x00,0x00,0x00,0x00,0x00,0x00,//" 2
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  0x00,0x06,0x01,0x01,0x02,0x02,0x04,0x04,0x00,0x00,0x00,0x00,0x00,0x00,0x00,0x00,//~ 94
};

#define OLED_H 8
#define OLED_W 128
#define LOGO_H 7
#define LOGO_W 56
static const unsigned char LogoDat[LOGO_H][LOGO_W]=
{
/*0x00,0x00,0x00,0x00,0x00,0x00,0x00,0x00,0x00,0x00,0x00,0x00,0x00,0x00,0x00,0x00,
0x00,0x00,0x80,0xC0,0xE0,0xF0,0xF8,0xFC,0xFE,0xFF,0xFF,0xFF,0xFF,0xFF,0x7F,0x3E,
0x1C,0x88,0xC0,0xE0,0xC0,0x80,0x00,0x00,0x00,0x00,0x00,0x00,0x00,0x00,0x00,0x00,
0x00,0x00,0x00,0x00,0x00,0x00,0x00,0x00,0x00,0x00,0x00,0x00,0x00,0x00,0x00,0x00,
0x00,0x00,0x80,0xC0,0xE0,0xF0,0xF8,0xFC,0xFE,0xFF,0xFF,0xFF,0xFF,0xFF,0x7F,0x3F,
0x1F,0x8F,0xC7,0xE3,0xF1,0xF8,0xFC,0xFE,0xFF,0xFF,0xFF,0xFF,0xFF,0xFF,0xFF,0xFE,
0xFC,0xF8,0xF0,0xE0,0xC0,0x80,0x00,0x00,0x00,0x00,0x00,0x00,0x00,0x00,0x00,0x00,
0x00,0x00,0x80,0xC0,0xE0,0xF0,0xF8,0xFC,0xFE,0xFF,0xFF,0xFF,0xFF,0xFF,0x7F,0x3F,
0x1F,0x8F,0xC7,0xE3,0xF1,0xF8,0xFC,0xFE,0xFF,0xFF,0xFF,0xFF,0xFF,0xFF,0xFF,0x7F,
0x0F,0x07,0x07,0x07,0x8F,0xFF,0xFF,0xFF,0xFF,0xFF,0xFF,0xFF,0xFF,0xFF,0xFF,0xFE,
0x7C,0x38,0x10,0x80,0xC0,0x80,0x00,0x00,0x7E,0xFF,0xFF,0xFF,0xFF,0xFF,0xFF,0xFF,
0xC7,0x83,0x83,0x83,0xC1,0xF8,0xFC,0xFE,0xFF,0xFF,0xFF,0xFF,0xFF,0xFF,0xFF,0x7F,
0x3F,0x1F,0x8F,0xC7,0xE3,0xF1,0xF8,0xFC,0xFE,0xFF,0xFF,0xFF,0xFF,0xFF,0xFF,0xFF,
0x7F,0x3F,0x1F,0x8F,0xC7,0xE3,0xF1,0xF8,0xFC,0xFE,0xFF,0xFF,0xFF,0xFF,0xFF,0x7E,
0x00,0x00,0x01,0x03,0x07,0x0F,0x1F,0x3F,0x7F,0xFF,0xFF,0xFF,0xFF,0xFF,0xFF,0x7F,
0x3F,0x1F,0x8F,0xC7,0xE3,0xF1,0xF8,0xFC,0xFE,0xFF,0xFF,0xFF,0xFF,0xFF,0xFF,0xFF,
0x7F,0x3F,0x1F,0x8F,0xC7,0xE3,0xF1,0xF8,0xFC,0xFE,0xFF,0xFF,0xFF,0xFF,0xFF,0x7F,
0x3F,0x1F,0x0F,0x07,0x03,0x01,0x00,0x00,0x00,0x00,0x00,0x00,0x00,0x00,0x00,0x00,
0x00,0x00,0x01,0x03,0x03,0x01,0x18,0x3C,0x7E,0xFF,0xFF,0xFF,0xFF,0xFF,0xFF,0xFF,
0xFF,0xFF,0xFF,0xE3,0xC1,0xC1,0xC1,0xE0,0xFC,0xFE,0xFF,0xFF,0xFF,0xFF,0xFF,0x7F,
0x3F,0x1F,0x0F,0x07,0x03,0x01,0x00,0x00,0x00,0x00,0x00,0x00,0x00,0x00,0x00,0x00,
0x00,0x00,0x00,0x00,0x00,0x00,0x00,0x00,0x00,0x00,0x00,0x00,0x00,0x00,0x00,0x00,
0x00,0x00,0x01,0x03,0x07,0x0F,0x1F,0x3F,0x7F,0xFF,0xFF,0xFF,0xFF,0xFF,0xFF,0x7F,
0x3F,0x1F,0x0F,0x07,0x03,0x01,0x00,0x00,0x00,0x00,0x00,0x00,0x00,0x00,0x00,0x00,
0x00,0x00,0x00,0x00,0x00,0x00,0x00,0x00*/

0x00,0x00,0x00,0x00,0x00,0x00,0x00,0x00,0x00,0x00,0x00,0x00,0x00,0x00,0x00,0x00,
0x00,0x00,0x80,0xC0,0x60,0xF0,0x58,0xFC,0x56,0xFF,0x55,0xFF,0x55,0xFF,0x55,0x3E,
0x14,0x88,0xC0,0xA0,0xC0,0x80,0x00,0x00,0x00,0x00,0x00,0x00,0x00,0x00,0x00,0x00,
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0x00,0x00,0x00,0x00,0x00,0x00,0x00,0x00
};
static unsigned char TestTab[129];

static void Write_Command(unsigned char Command)
{
    TestTab[0] = 0x00;
    TestTab[1] = Command;
    I2C_Send(TestTab, 2);
}

static void Write_Data(unsigned char Data)
{
    TestTab[0] = 0x40;
    TestTab[1] = Data;
    I2C_Send(TestTab, 2);
}

static void Write_DataBuff(unsigned char *Data, unsigned char Len)
{
    unsigned char i;
    
    TestTab[0] = 0x40;
    for (i=0;i<Len;i++)
    {
        TestTab[i+1] = *(Data+i);
    }
    I2C_Send(TestTab, Len+1);
}

void OLED_SetPos(unsigned char x, unsigned char y) 
{
    Write_Command(0xb0+y);
    Write_Command(((x&0xf0)>>4)|0x10);
    Write_Command((x&0x0f));
}

void OLED_DispLogo(void)
{
    unsigned char i;
    
    for (i=0;i<LOGO_H;i++)
    {
        OLED_SetPos(36,i);
        Write_DataBuff((unsigned char *)LogoDat[i],LOGO_W);
    }
}

//6x8
static void OLED_DispStr6x8(unsigned char x, unsigned char y, char *ch)
{
    unsigned char c=0,i=0;
    
    while (*(ch+i) != '\0')
    {    
        c = *(ch+i)-32;
        if(x>126){x=0;y++;}
        OLED_SetPos(x,y);  
        if(c < 95)
        {
            Write_DataBuff((unsigned char *)CharTab6x8[c],6);
        }
        x+=6;
        i++;
    }
}

//8x16
static void OLED_DispStr8x16(unsigned char x, unsigned char y, char *ch)
{
    unsigned char c=0,i=0;
    
    while (*(ch+i) != '\0')
    {    
        c = *(ch+i)-32;
        if(x>126){x=0;y+=2;}
        OLED_SetPos(x,y);  
        if(c < 95)
        {
            Write_DataBuff((unsigned char *)CharTab8x16[c],8);
            OLED_SetPos(x,y+1);
            Write_DataBuff((unsigned char *)(CharTab8x16[c]+8),8);
        }
        x+=8;
        i++;
    }
}

void OLED_DispStr(unsigned char x, unsigned char y, char *ch)
{
    OLED_DispStr8x16(x,y,ch);
}

void OLED_Clear(void)
{
    unsigned char i,n;
    
    Write_Command(0xD3);//-set display offset
    Write_Command(0x00);//
    Write_Command(0x40);//--set start line address
    
    for(i=0;i<OLED_H;i++)
    {
        Write_Command(0xb0+i);
        Write_Command(0x00);
        Write_Command(0x10);
        for(n=0;n<OLED_W;n++) Write_Data(0); 
    }
}

void OLED_Init(void)
{
    Write_Command(0xAE);//--display off
    Write_Command(0x00);//---set low column address
    Write_Command(0x10);//---set high column address
    Write_Command(0x40);//--set start line address  
    Write_Command(0xB0);//--set page address
    Write_Command(0x81); // contract control
    Write_Command(0xFF);//--128   
    Write_Command(0xA1);//set segment remap 
    Write_Command(0xA6);//--normal / reverse
    Write_Command(0xA8);//--set multiplex ratio(1 to 64)
    Write_Command(0x3F);//--1/32 duty
    Write_Command(0xC8);//Com scan direction
    Write_Command(0xD3);//-set display offset
    Write_Command(0x00);//
    
    Write_Command(0xD5);//set osc division
    Write_Command(0x80);
    
    Write_Command(0xD8);//set area color mode off
    Write_Command(0x05);
    
    Write_Command(0xD9);//Set Pre-Charge Period
    Write_Command(0xF1);
    
    Write_Command(0xDA);//set com pin configuartion
    Write_Command(0x12);
    
    Write_Command(0xDB);//set Vcomh
    Write_Command(0x30);
    
    Write_Command(0x8D);//set charge pump enable
    Write_Command(0x14);
    
    Write_Command(0xAF);//--turn on oled panel
    
    OLED_Clear();
    OLED_DispLogo();
    OLED_DispStr(0, 6, "MS179x EVBOARD ");
}
